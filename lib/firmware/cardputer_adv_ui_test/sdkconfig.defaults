## lib/firmware/cardputer_adv_ui_test/sdkconfig.defaults
```kconfig
# Match the 8 MB flash chip used by the Cardputer ADV target.
# CONFIG_ESPTOOLPY_FLASHSIZE_2MB is not set
CONFIG_ESPTOOLPY_FLASHSIZE_8MB=y
CONFIG_ESPTOOLPY_FLASHSIZE="8MB"

# The smoke app does not use TLS. Disabling the bundle keeps this PlatformIO
# ESP-IDF setup close to the known-good pocket_synth project.
# CONFIG_MBEDTLS_CERTIFICATE_BUNDLE is not set
```

## sdkconfig.defaults
```kconfig
# Match the 8 MB flash chip on the Cardputer ADV.
# CONFIG_ESPTOOLPY_FLASHSIZE_2MB is not set
CONFIG_ESPTOOLPY_FLASHSIZE_8MB=y
CONFIG_ESPTOOLPY_FLASHSIZE="8MB"

# The app does not use TLS yet, and the generated certificate bundle target
# fails on this PlatformIO/ESP-IDF setup.
# CONFIG_MBEDTLS_CERTIFICATE_BUNDLE is not set

# Cardputer ADV uses GPIO43 for I2S LRCK, so the default ESP32-S3 UART console
# pins would collide with audio. Keep logs and serial commands on native USB.
# CONFIG_ESP_CONSOLE_UART_DEFAULT is not set
CONFIG_ESP_CONSOLE_USB_SERIAL_JTAG=y
CONFIG_ESP_CONSOLE_SECONDARY_NONE=y
# CONFIG_ESP_CONSOLE_SECONDARY_USB_SERIAL_JTAG is not set

# USB Host diagnostics need hub enumeration for powered hub + MIDI keyboard tests.
CONFIG_USB_HOST_HUBS_SUPPORTED=y
CONFIG_USB_HOST_CONTROL_TRANSFER_MAX_SIZE=1024
CONFIG_USB_HOST_HW_BUFFER_BIAS_PERIODIC_OUT=y
```
